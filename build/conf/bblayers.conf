## build/conf/bblayers.conf
```bitbake
# POKY_BBLAYERS_CONF_VERSION is increased each time build/conf/bblayers.conf
# changes incompatibly
POKY_BBLAYERS_CONF_VERSION = "2"

BBPATH = "${TOPDIR}"
BBFILES ?= ""

BBLAYERS ?= " \
  /yocto/layers/poky/meta \
  /yocto/layers/poky/meta-poky \
  /yocto/layers/poky/meta-yocto-bsp \
  /yocto/layers/meta-raspberrypi \
  /yocto/layers/meta-openembedded/meta-oe \
  /yocto/layers/meta-openembedded/meta-python \
  /yocto/layers/meta-openembedded/meta-multimedia \
  /yocto/layers/meta-openembedded/meta-networking \
  /yocto/layers/meta-openembedded/meta-gnome \
  /yocto/layers/meta-openembedded/meta-xfce \
  "
```

## layers/meta-acs/conf/layer.conf
```bitbake
# We have a conf and classes directory, add to BBPATH
BBPATH .= ":${LAYERDIR}"

# We have recipes-* directories, add to BBFILES
BBFILES += "${LAYERDIR}/recipes-*/*/*.bb \
            ${LAYERDIR}/recipes-*/*/*.bbappend"

BBFILE_COLLECTIONS += "meta-acs"
BBFILE_PATTERN_meta-acs = "^${LAYERDIR}/"
BBFILE_PRIORITY_meta-acs = "6"

LAYERDEPENDS_meta-acs = "core"
LAYERSERIES_COMPAT_meta-acs = "dunfell"
```

## layers/meta-qt5-devel/conf/layer.conf
```bitbake
# We have a conf and classes directory, add to BBPATH
BBPATH .= ":${LAYERDIR}"

# We have recipes-* directories, add to BBFILES
BBFILES += "${LAYERDIR}/recipes-*/*/*.bb \
            ${LAYERDIR}/recipes-*/*/*.bbappend"

BBFILE_COLLECTIONS += "qt5-devel"
BBFILE_PATTERN_qt5-devel = "^${LAYERDIR}/"
BBFILE_PRIORITY_qt5-devel = "6"

LAYERDEPENDS_qt5-devel = "qt5-layer"
LAYERSERIES_COMPAT_qt5-devel = "dunfell"
```
